## app/Kconfig
```kconfig
menuconfig LED_SUBSYSTEM
    bool "LED Subsystem"
    default y

if LED_SUBSYSTEM

choice BLINK_SLEEP_TIME
    prompt "LED blink speed time"
    default BLINK_SLEEP_1000MS

config BLINK_SLEEP_250MS
    bool "250ms (fast)"

config BLINK_SLEEP_1000MS
    bool "1s (medium)"

config BLINK_SLEEP_2000MS
    bool "2s (slow)"

endchoice

config BLINK_SLEEP_TIME_MS
    int
    depends on LED_SUBSYSTEM
    default 250 if BLINK_SLEEP_250MS
    default 1000 if BLINK_SLEEP_1000MS
    default 2000 if BLINK_SLEEP_2000MS


menuconfig LED_ADVANCED_SETTINGS
    bool "Advanced LED Settings"
    default n

if LED_ADVANCED_SETTINGS
config LED_BRIGHTNESS
    int "LED brightness (0-100)"
    range 0 100
    default 50

config LED_FADE_DURATION_MS
    int "Fade duration (ms)"
    range 0 5000
    default 500

menu "Expert Settings"
    visible if LED_ADVANCED_SETTINGS

    config LED_ENABLE_DEBUG
        bool "Enable LED debugging"
        default n

    config LED_CUSTOM_BLINK_PATTERN
        bool "Custom blink pattern"
        default n
endmenu

endif

endif

menuconfig APP_HEARTBEAT_PERIOD_MS
    int "Fade duration (ms)"
    range 0 2000
    default 500

source "Kconfig.zephyr"
```

## app/boards/my_board/Kconfig.defconfig
```kconfig
if BOARD_MY_BOARD

configdefault NET_L2_ETHERNET
	default y

endif # BOARD_MY_BOARD
```

## app/boards/our_board/board.yml
```yaml
board:
  name: our_board
  full_name: Our Board
  vendor: iomico
  socs:
    - name: stm32h7s3xx
      variants:
        - name: ext_flash_app
```
